## sdkconfig.defaults
```kconfig
CONFIG_IDF_TARGET="esp32s2"
CONFIG_USB_ENABLED=y
CONFIG_USB_CDC_ENABLED=y
#
# TinyUSB
#
CONFIG_USB_ENABLED=y

#
# USB task configuration
#
# CONFIG_USB_DO_NOT_CREATE_TASK is not set
CONFIG_USB_TASK_PRIORITY=5
# end of USB task configuration

#
# Descriptor configuration
#
CONFIG_USB_DESC_USE_ESPRESSIF_VID=y
CONFIG_USB_DESC_USE_DEFAULT_PID=y
CONFIG_USB_DESC_BCDDEVICE=0x0100
CONFIG_USB_DESC_MANUFACTURER_STRING="Espressif Systems"
CONFIG_USB_DESC_PRODUCT_STRING="Espressif Device"
CONFIG_USB_DESC_SERIAL_STRING="123456"
CONFIG_USB_DESC_CDC_STRING="Espressif CDC Device"
# end of Descriptor configuration

# CONFIG_USB_MSC_ENABLED is not set
CONFIG_USB_CDC_ENABLED=y
CONFIG_USB_CDC_RX_BUFSIZE=64
CONFIG_USB_CDC_TX_BUFSIZE=64
CONFIG_USB_DEBUG_LEVEL=0
# end of TinyUSB

CONFIG_ESP32S2_SPIRAM_SUPPORT=y
#
# SPI RAM config
#
# CONFIG_SPIRAM_TYPE_AUTO is not set
# CONFIG_SPIRAM_TYPE_ESPPSRAM16 is not set
# CONFIG_SPIRAM_TYPE_ESPPSRAM32 is not set
CONFIG_SPIRAM_TYPE_ESPPSRAM64=y
CONFIG_SPIRAM_SIZE=8388608
# end of SPI RAM config

CONFIG_DEFAULT_PSRAM_CLK_IO=30
#
# PSRAM clock and cs IO for ESP32S2
#
CONFIG_DEFAULT_PSRAM_CS_IO=26
# end of PSRAM clock and cs IO for ESP32S2

# CONFIG_SPIRAM_FETCH_INSTRUCTIONS is not set
# CONFIG_SPIRAM_RODATA is not set
# CONFIG_SPIRAM_SPEED_80M is not set
CONFIG_SPIRAM_SPEED_40M=y
# CONFIG_SPIRAM_SPEED_26M is not set
# CONFIG_SPIRAM_SPEED_20M is not set
CONFIG_SPIRAM=y
CONFIG_SPIRAM_BOOT_INIT=y
# CONFIG_SPIRAM_IGNORE_NOTFOUND is not set
CONFIG_SPIRAM_USE_MEMMAP=y
# CONFIG_SPIRAM_USE_CAPS_ALLOC is not set
# CONFIG_SPIRAM_USE_MALLOC is not set
CONFIG_SPIRAM_MEMTEST=y
# CONFIG_SPIRAM_ALLOW_BSS_SEG_EXTERNAL_MEMORY is not set
#
# LWIP
#
CONFIG_LWIP_LOCAL_HOSTNAME="UMFeatherS2"
# end of LWIP
```
